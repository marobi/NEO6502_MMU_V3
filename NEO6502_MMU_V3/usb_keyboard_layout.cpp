#include <Arduino.h>
#include "Adafruit_TinyUSB.h"
#include "usb_keyboard_layout.h"

// ============================================================
// usb_keyboard_layout.cpp
// NEO6502_MMU - USB boot-keyboard locale mapping
//
// Built-in layouts are table-driven. The active layout is a pointer to a
// USBKeyboardLayoutTable, so a later storage-backed loader can populate the
// same structure and install it without changing the HID input pipeline.
//
// Layout scope:
//   - US preserves the V26/V27a behavior.
//   - DE implements German QWERTZ and ASCII-safe punctuation.
//   - ä/ö/ü/ß/€/§ and dead keys are intentionally mapped to 0 until NEOX has
//     a defined extended keyboard/character encoding.
// ============================================================

static const USBKeyboardLayoutTable g_usLayout = {
  "US",
  {
  0x00, 0x00, 0x00, 0x00, 0x61, 0x62, 0x63, 0x64, 0x65, 0x66, 0x67, 0x68, 0x69, 0x6A, 0x6B, 0x6C,
  0x6D, 0x6E, 0x6F, 0x70, 0x71, 0x72, 0x73, 0x74, 0x75, 0x76, 0x77, 0x78, 0x79, 0x7A, 0x31, 0x32,
  0x33, 0x34, 0x35, 0x36, 0x37, 0x38, 0x39, 0x30, 0x0D, 0x1B, 0x08, 0x09, 0x20, 0x2D, 0x3D, 0x5B,
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  0x00, 0x00, 0x00, 0x00, 0x00, 0x00, 0x00, 0x00, 0x00, 0x00, 0x00, 0x00, 0x00, 0x00, 0x00, 0x00
  },
  {
  0x00, 0x00, 0x00, 0x00, 0x41, 0x42, 0x43, 0x44, 0x45, 0x46, 0x47, 0x48, 0x49, 0x4A, 0x4B, 0x4C,
  0x4D, 0x4E, 0x4F, 0x50, 0x51, 0x52, 0x53, 0x54, 0x55, 0x56, 0x57, 0x58, 0x59, 0x5A, 0x21, 0x40,
  0x23, 0x24, 0x25, 0x5E, 0x26, 0x2A, 0x28, 0x29, 0x0D, 0x1B, 0x08, 0x09, 0x20, 0x5F, 0x2B, 0x7B,
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  0x00, 0x00, 0x00, 0x00, 0x00, 0x00, 0x00, 0x00, 0x00, 0x00, 0x00, 0x00, 0x00, 0x00, 0x00, 0x00
  },
  {
  0x00, 0x00, 0x00, 0x00, 0x01, 0x02, 0x03, 0x04, 0x05, 0x06, 0x07, 0x08, 0x09, 0x0A, 0x0B, 0x0C,
  0x0D, 0x0E, 0x0F, 0x10, 0x11, 0x12, 0x13, 0x14, 0x15, 0x16, 0x17, 0x18, 0x19, 0x1A, 0x00, 0x00,
  0x00, 0x00, 0x00, 0x1E, 0x00, 0x00, 0x00, 0x00, 0x0D, 0x1B, 0x08, 0x09, 0x00, 0x1F, 0x00, 0x1B,
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  0x00, 0x00, 0x00, 0x00, 0x00, 0x00, 0x00, 0x00, 0x00, 0x00, 0x00, 0x00, 0x00, 0x00, 0x00, 0x00
  },
  0
};

static const USBKeyboardLayoutTable g_deLayout = {
  "DE",
  {
  0x00, 0x00, 0x00, 0x00, 0x61, 0x62, 0x63, 0x64, 0x65, 0x66, 0x67, 0x68, 0x69, 0x6A, 0x6B, 0x6C,
  0x6D, 0x6E, 0x6F, 0x70, 0x71, 0x72, 0x73, 0x74, 0x75, 0x76, 0x77, 0x78, 0x7A, 0x79, 0x31, 0x32,
  0x33, 0x34, 0x35, 0x36, 0x37, 0x38, 0x39, 0x30, 0x0D, 0x1B, 0x08, 0x09, 0x20, 0x00, 0x00, 0x00,
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  0x00, 0x00, 0x00, 0x00, 0x00, 0x00, 0x00, 0x00, 0x00, 0x00, 0x00, 0x00, 0x00, 0x00, 0x00, 0x00
  },
  {
  0x00, 0x00, 0x00, 0x00, 0x41, 0x42, 0x43, 0x44, 0x45, 0x46, 0x47, 0x48, 0x49, 0x4A, 0x4B, 0x4C,
  0x4D, 0x4E, 0x4F, 0x50, 0x51, 0x52, 0x53, 0x54, 0x55, 0x56, 0x57, 0x58, 0x5A, 0x59, 0x21, 0x22,
  0x00, 0x24, 0x25, 0x26, 0x2F, 0x28, 0x29, 0x3D, 0x0D, 0x1B, 0x08, 0x09, 0x20, 0x3F, 0x00, 0x00,
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  0x00, 0x00, 0x00, 0x00, 0x00, 0x00, 0x00, 0x00, 0x00, 0x00, 0x00, 0x00, 0x00, 0x00, 0x00, 0x00
  },
  {
  0x00, 0x00, 0x00, 0x00, 0x01, 0x02, 0x03, 0x04, 0x05, 0x06, 0x07, 0x08, 0x09, 0x0A, 0x0B, 0x0C,
  0x0D, 0x0E, 0x0F, 0x10, 0x11, 0x12, 0x13, 0x14, 0x15, 0x16, 0x17, 0x18, 0x1A, 0x19, 0x00, 0x00,
  0x00, 0x00, 0x00, 0x1E, 0x00, 0x00, 0x00, 0x00, 0x0D, 0x1B, 0x08, 0x09, 0x00, 0x1F, 0x00, 0x1B,
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  0x00, 0x00, 0x00, 0x00, 0x00, 0x00, 0x00, 0x00, 0x00, 0x00, 0x00, 0x00, 0x00, 0x00, 0x00, 0x00
  },
  0
};

static USBKeyboardLocale g_keyboardLocale = USB_KEYBOARD_DEFAULT_LOCALE;
static const USBKeyboardLayoutTable* g_activeLayout = nullptr;

static bool usb_keyboard_shift_active(uint8_t modifier) {
  return (modifier & (KEYBOARD_MODIFIER_LEFTSHIFT | KEYBOARD_MODIFIER_RIGHTSHIFT)) != 0;
}

static bool usb_keyboard_ctrl_active(uint8_t modifier) {
  return (modifier & (KEYBOARD_MODIFIER_LEFTCTRL | KEYBOARD_MODIFIER_RIGHTCTRL)) != 0;
}

static const USBKeyboardLayoutTable* usb_keyboard_builtin_layout_for_locale(USBKeyboardLocale locale) {
  switch (locale) {
    case USB_KEYBOARD_LOCALE_DE: return &g_deLayout;
    case USB_KEYBOARD_LOCALE_US:
    default:                    return &g_usLayout;
  }
}

void usb_keyboard_set_locale(USBKeyboardLocale locale) {
  switch (locale) {
    case USB_KEYBOARD_LOCALE_US:
    case USB_KEYBOARD_LOCALE_DE:
      g_keyboardLocale = locale;
      g_activeLayout = usb_keyboard_builtin_layout_for_locale(locale);
      break;
    default:
      g_keyboardLocale = USB_KEYBOARD_LOCALE_US;
      g_activeLayout = &g_usLayout;
      break;
  }
}

USBKeyboardLocale usb_keyboard_get_locale() {
  return g_keyboardLocale;
}

static const USBKeyboardLayoutTable* usb_keyboard_active_layout() {
  if (!g_activeLayout)
    g_activeLayout = usb_keyboard_builtin_layout_for_locale(g_keyboardLocale);

  return g_activeLayout ? g_activeLayout : &g_usLayout;
}

const char* usb_keyboard_get_locale_name() {
  return usb_keyboard_active_layout()->name;
}

const USBKeyboardLayoutTable* usb_keyboard_get_active_layout_table() {
  return usb_keyboard_active_layout();
}

bool usb_keyboard_set_active_layout_table(const USBKeyboardLayoutTable* layout) {
  if (!layout) {
    usb_keyboard_set_locale(USB_KEYBOARD_DEFAULT_LOCALE);
    return false;
  }

  g_activeLayout = layout;

  if (layout == &g_deLayout)
    g_keyboardLocale = USB_KEYBOARD_LOCALE_DE;
  else if (layout == &g_usLayout)
    g_keyboardLocale = USB_KEYBOARD_LOCALE_US;
  else
    g_keyboardLocale = USB_KEYBOARD_LOCALE_CUSTOM;

  return true;
}

uint8_t usb_keyboard_keycode_to_ascii_locale(uint8_t keycode, uint8_t modifier) {
  const USBKeyboardLayoutTable* layout = usb_keyboard_active_layout();

  if (keycode >= USB_KEYBOARD_LAYOUT_KEY_COUNT)
    return 0;

  if (usb_keyboard_ctrl_active(modifier))
    return layout->ctrl[keycode];

  if (usb_keyboard_shift_active(modifier))
    return layout->shifted[keycode];

  return layout->normal[keycode];
}
